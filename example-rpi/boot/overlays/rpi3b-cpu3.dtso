/dts-v1/;
/plugin/;
/{
    fragment@0 {
        target-path="/";
        __overlay__ {
	cpus {
		#address-cells = <0x01>;
		#size-cells = <0x00>;
		enable-method = "brcm,bcm2836-smp";
		phandle = <0x8d>;

		cpu@3 {
			device_type = "cpu";
			compatible = "arm,cortex-a53";
			reg = <0x03>;
			enable-method = "spin-table";
/*
			cpu-release-addr = <0x00 0xf0>;
*/
			cpu-release-addr = <0x00 0xd8>;
			d-cache-size = <0x8000>;
			d-cache-line-size = <0x40>;
			d-cache-sets = <0x80>;
			i-cache-size = <0x8000>;
			i-cache-line-size = <0x40>;
			i-cache-sets = <0x100>;
			next-level-cache = <0x21>;
			phandle = <0x25>;
		};
	};
        };
    };
};

